## conf/distro/fnordpipe.conf
```bitbake
# distribution config
DISTRO = "fnordpipe"
DISTRO_NAME = "fnordpipe"
DISTRO_VERSION = "${DATE}"

TARGET_VENDOR = "-fnordpipe"

IMAGE_FSTYPES ?= "tar.bz2 ext4 cpio.gz"
PACKAGE_CLASSES = "package_deb"

GLIBC_GENERATE_LOCALES = "en_US.UTF-8"
IMAGE_LINGUAS = "en-us"

ROOT_HOME = "/root"

require conf/distro/include/distrofeatures.inc
require conf/distro/include/providers.inc

PACKAGECONFIG_pn-systemd += " \
  networkd \
  resolved \
  "
```

## conf/distro/include/distrofeatures.inc
```bitbake
DISTRO_FEATURES_append += " \
  systemd \
  xen \
  "

DISTRO_FEATURES_remove = " \
  3g \
  alsa \
  bluetooth \
  irda \
  nfs \
  opengl \
  pulseaudio \
  zeroconf \
  wayland \
  wifi \
  x11 \
  "

DISTRO_FEATURES_BACKFILL_CONSIDERED = " \
  pulseaudio \
  "

VIRTUAL-RUNTIME_init_manager = "systemd"
DISTRO_FEATURES_BACKFILL_CONSIDERED = "sysvinit"
```

## conf/distro/include/providers.inc
```bitbake
PREFERRED_VERSION_xen = "4.9.%"
PREFERRED_VERSION_openssl = "1.1.%"
PREFERRED_VERSION_openssl-native = "1.1.%"
PREFERRED_VERSION_nativesdl-openssl = "1.1.%"
```

## conf/layer.conf
```bitbake
#We have a conf and classes directory, add to BBPATH
BBPATH .= ":${LAYERDIR}"

# We have a recipes-* directories, add to BBFILES
BBFILES += "${LAYERDIR}/recipes-*/*/*.bb \
  ${LAYERDIR}/recipes-*/*/*.bbappend"

BBFILE_COLLECTIONS += "fnordpipe"
BBFILE_PATTERN_fnordpipe := "^${LAYERDIR}/"
BBFILE_PRIORITY_fnordpipe = "6"

LAYERVERSION_fnordpipe = "1"
```

## conf/machine/amd64.conf
```bitbake
#@TYPE: Machine
#@NAME: amd64
#@DESCRIPTION: machine configuration for x86_64 boards

DEFAULTTUNE ?= "core2-64"
require conf/machine/include/tune-core2.inc

KERNEL_IMAGETYPE = "bzImage"
SERIAL_CONSOLES = "115200;ttyS0 115200;ttyS1"

MACHINE_FEATURES += "x86"
MACHINE_ESSENTIAL_EXTRA_RDEPENDS += "v86d"

require conf/machine/include/machinefeatures.inc
require conf/machine/include/providers.inc
```

## conf/machine/dl120g6.conf
```bitbake
#@TYPE: Machine
#@NAME: dl120g6
#@DESCRIPTION: HP DL120 G6

DEFAULTTUNE ?= "core2-64"
require conf/machine/include/tune-core2.inc

KERNEL_IMAGETYPE = "bzImage"
SERIAL_CONSOLES = "115200;ttyS0 115200;ttyS1"

MACHINE_FEATURES += "x86"
MACHINE_ESSENTIAL_EXTRA_RDEPENDS += "v86d"

MACHINE_FEATURES_remove = " \
  alsa \
  bluetooth \
  efi \
  irda \
  screen \
  touchscreen \
  wifi \
  "

MACHINE_EXTRA_RRECOMMENDS = " \
  kernel-module-tg3 \
  kernel-module-ahci \
  kernel-module-ata-piix \
  "

require conf/machine/include/providers.inc
```

## conf/machine/include/machinefeatures.inc
```bitbake
MACHINE_FEATURES_remove = " \
  alsa \
  bluetooth \
  efi \
  irda \
  screen \
  touchscreen \
  wifi \
  "
```

## conf/machine/include/providers.inc
```bitbake
PREFERRED_PROVIDER_virtual/kernel ?= "linux-yocto"
PREFERRED_PRODIDER_bootloader ?= "syslinux"
PREFERRED_PRODIDER_virtual/bootloader ?= "syslinux"
```
